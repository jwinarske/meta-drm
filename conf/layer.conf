## conf/layer.conf
```bitbake
# We have a conf and classes directory, append to BBPATH
BBPATH .= ":${LAYERDIR}"

BBFILES += "\
    ${LAYERDIR}/recipes*/*/*.bb \
    ${LAYERDIR}/recipes*/*/*.bbappend \
"

BBFILE_COLLECTIONS += "drm-layer"
BBFILE_PATTERN_drm-layer := "^${LAYERDIR}/"
BBFILE_PRIORITY_drm-layer = "12"

LAYERSERIES_COMPAT_drm-layer = "whinlatter"
```
